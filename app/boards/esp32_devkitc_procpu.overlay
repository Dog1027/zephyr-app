/* Devicetree overlay for esp32_devkitc/esp32/procpu.
 * Zephyr picks boards/<board>_<qualifiers>.overlay automatically;
 * when a board overlay exists, app.overlay is NOT used.
 */

/ {
    chosen {
        zephyr,console = &uart0;
        zephyr,shell-uart = &uart0;
    };

    aliases {
    };
};
