## Kconfig
```
menu "Application"

config APP_HEARTBEAT_INTERVAL_MS
	int "Heartbeat log interval (ms)"
	default 1000
	help
	  Interval between heartbeat log messages printed by main().

endmenu

source "Kconfig.zephyr"
```

## prj.conf
```kconfig
CONFIG_SERIAL=y
CONFIG_CONSOLE=y
CONFIG_PRINTK=y

CONFIG_LOG=y
```

## src/main.c
```c
#include <zephyr/kernel.h>
#include <zephyr/logging/log.h>
#include <zephyr/app_version.h>

LOG_MODULE_REGISTER(app, LOG_LEVEL_INF);

int main(void)
{
    LOG_INF("App v%s running on %s", APP_VERSION_STRING, CONFIG_BOARD_TARGET);

    while (1) {
        LOG_INF("heartbeat");
        k_msleep(CONFIG_APP_HEARTBEAT_INTERVAL_MS);
    }

    return 0;
}
```
